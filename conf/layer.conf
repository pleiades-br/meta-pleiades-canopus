## conf/layer.conf
```bitbake
# We have a conf and classes directory, add to BBPATH
BBPATH .= ":${LAYERDIR}"

# We have recipes-* directories, add to BBFILES
BBFILES += "${LAYERDIR}/recipes-*/*/*.bb \
            ${LAYERDIR}/recipes-*/*/*.bbappend"

BBFILE_COLLECTIONS += "meta-pleiades-canopus"
BBFILE_PATTERN_meta-pleiades-canopus = "^${LAYERDIR}/"
BBFILE_PRIORITY_meta-pleiades-canopus = "98"

LAYERSERIES_COMPAT_meta-pleiades-canopus = "kirkstone scarthgap"
```

## conf/machine/plds-verdin-imx8mp-canopus.conf
```bitbake
#@TYPE: Machine
#@NAME: Verdin iMX8M Plus for Canopus board
#@SOC: i.MX8MP
#@DESCRIPTION: Machine configuration for Toradex Verdin iMX8M Plus SoM
#@MAINTAINER: Aluisio L Victal <aluisio.victal@bikubelabs.com>

include conf/machine/verdin-imx8mp.conf

MACHINE_NAME = "plds-verdin-imx8mp-canopus"

KERNEL_DEVICETREE = " \
    ${KERNEL_DTB_PREFIX}imx8mp-verdin-wifi-canopus.dtb "

MACHINE_PREFIX:plds-verdin-imx8mp-canopus = "verdin-imx8mp"
SOC_ATF_BOOT_UART_BASE:plds-verdin-imx8mp-canopus = "0x30880000"
```
